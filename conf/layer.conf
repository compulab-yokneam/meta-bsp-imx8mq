## conf/layer.conf
```bitbake
# We have a conf and classes directory, append to BBPATH
BBPATH .= ":${LAYERDIR}"

# We have a recipes directory containing .bb and .bbappend files, add to BBFILES
BBFILES += "${LAYERDIR}/recipes-*/*/*.bb \
            ${LAYERDIR}/recipes-*/*/*.bbappend"

BBFILE_COLLECTIONS += "compulab-bsp-imx8mq"
BBFILE_PATTERN_compulab-bsp-imx8mq := "^${LAYERDIR}/"
BBFILE_PRIORITY_compulab-bsp-imx8mq = "9"

BBMASK += "meta-compulab/recipes-xfce"
BBMASK += "meta-compulab/recipes-kernel"
BBMASK += "meta-compulab/recipes-graphics/wayland/weston_%.imx.bbappend"

LAYERSERIES_COMPAT_compulab-bsp-imx8mq = "zeus"
```

## conf/machine/cl-som-imx8.conf
```bitbake
#@TYPE: Machine
#@NAME: CompuLab i.MX8MQ Evaluation Kit
#@SOC: i.MX8MQ
#@DESCRIPTION: Machine configuration for CompuLab i.MX8MQ EVK
#@MAINTAINER: CompuLab <compulab@compulab.com>

MACHINEOVERRIDES =. "imx-boot-container:mx8mq:compulab-mx8mq:"

require conf/machine/include/imx-base.inc
require conf/machine/include/arm/armv8a/tune-cortexa53.inc

DEFAULTTUNE:use-mainline-bsp = "cortexa53-crypto"

MACHINE_FEATURES += "pci wifi bluetooth"
MACHINE_FEATURES:append:use-nxp-bsp = " optee "

MACHINE_SOCARCH_FILTER:append:mx8mq = " virtual/libopenvg virtual/libgles1 virtual/libgles2 virtual/egl virtual/mesa virtual/libgl virtual/libg2d"

KERNEL_DEVICETREE = "compulab/cl-som-imx8.dtb \
	compulab/sbc-imx8.dtb \
	compulab/sbc-imx8-thermal.dtb \
	compulab/sbc-imx8-bluetooth.dtb \
	compulab/sbc-imx8-m4.dtb \
	compulab/sbc-imx8-no-edid.dtb \
	compulab/sbc-imx8-no-wp.dtb \
	compulab/sbc-imx8-emmc-low.dtb \
	compulab/sbc-imx8-lvds-lcdif.dtb \
	compulab/sbc-imx8-lvds-dcss.dtb \
"

IMAGE_INSTALL:append = " \
	kernel-image \
	kernel-modules \
	kernel-devicetree \
"

# Linux kernel
PREFERRED_PROVIDER_virtual/kernel:compulab-mx8mq = "linux-compulab"
PREFERRED_PROVIDER_virtual/bootloader:compulab-mx8mq = "u-boot-compulab"
PREFERRED_PROVIDER_linux-imx-mfgtool:compulab-mx8mq = "linux-compulab-mfgtool"
PREFERRED_PROVIDER_linux-compulab-mfgtool:compulab-mx8mq = "linux-compulab-mfgtool"

# bootloader
IMX_DEFAULT_BOOTLOADER:use-nxp-bsp = "u-boot-compulab"
IMX_DEFAULT_BOOTLOADER:use-mainline-bsp = "u-boot-compulab"
PREFERRED_PROVIDER_virtual/bootloader:compulab-mx8mq = "u-boot-compulab"

PREFERRED_RROVIDER_u-boot-fw-utils = "libubootenv-bin"

UBOOT_CONFIG ??= "sd"
UBOOT_CONFIG[sd] = "cl-som-imx8_defconfig,sdcard"
UBOOT_CONFIG[mfgtool] = "cl-som-imx8_defconfig"
SPL_BINARY = "spl/u-boot-spl.bin"

# Set DDR FIRMWARE
DDR_FIRMWARE_NAME = " \
    lpddr4_pmu_train_1d_imem.bin \
    lpddr4_pmu_train_1d_dmem.bin \
    lpddr4_pmu_train_2d_imem.bin \
    lpddr4_pmu_train_2d_dmem.bin \
"

# Set u-boot DTB
UBOOT_DTB_NAME = "cl-som-imx8.dtb"

# Set ATF platform name
ATF_PLATFORM = "imx8mq"

# Extra firmware package name, that is required to build boot container for fslc bsp
IMX_EXTRA_FIRMWARE = "firmware-imx-8m"
#
# Set imx-mkimage boot target
IMXBOOT_TARGETS ?= "flash_evk"
IMX_BOOT_SOC_TARGET = "iMX8M"

# Set Serial console
SERIAL_CONSOLES = "115200;ttymxc2"

IMAGE_BOOTLOADER = "imx-boot"

LOADADDR = ""
UBOOT_SUFFIX = "bin"
UBOOT_MAKE_TARGET = ""
IMX_BOOT_SEEK = "33"

OPTEE_BIN_EXT = "8mq"
TEE_LOAD_ADDR = "0x56000000"
PLATFORM_FLAVOR:cl-som-imx8 = "mx8mq_cl_som_imx8"

# Add additional firmware
MACHINE_FIRMWARE:append = " linux-firmware-iwlwifi-8265 linux-firmware-ibt firmware-imx-vpu-imx8 linux-firmware-ax200 linux-firmware-ax210 "
MACHINE_FIRMWARE:remove = " linux-firmware-ath10k"

IMX_DEFAULT_BSP = "nxp"
```
